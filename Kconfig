## Kconfig
```kconfig
mainmenu "Firmware configuration"

choice BOARD
    prompt "Board"
    default BOARD_NUCLEO_F411RE

source "bsp/boards/st/nucleo_f411re/Kconfig"
source "bsp/boards/st/nucleo_f439zi/Kconfig"

endchoice

source "bsp/soc/st/stm32f4/Kconfig"

config BOARD_NAME
    string
    default "nucleo_f411re" if BOARD_NUCLEO_F411RE
    default "nucleo_f439zi" if BOARD_NUCLEO_F439ZI

config BOARD_PATH
    string
    default "st/nucleo_f411re" if BOARD_NUCLEO_F411RE
    default "st/nucleo_f439zi" if BOARD_NUCLEO_F439ZI

config MCU_VARIANT
    string
    default "stm32f411re" if BOARD_NUCLEO_F411RE
    default "stm32f439zi" if BOARD_NUCLEO_F439ZI

menu "ARTOS"

config ARTOS_BUILD_TYPE
    string
    option env="ARTOS_BUILD_TYPE"

config ARTOS
    bool "Enable ARTOS"
    default y
    help
      Build the kernel and Cortex-M port and start the kernel tick.
      The buffered console and serial monitor require ARTOS.

config ARTOS_TICK_HZ
    int "Kernel ticks per second"
    range 1 1000000
    default 1000
    depends on ARTOS
    help
      The CPU port checks that the board timer clock divides exactly by
      this frequency and that the reload fits the hardware timer.

config ARTOS_SCHEDULER_MIN_CYCLES_REMAINING
    int "Minimum SysTick cycles remaining to schedule on a tick"
    range 0 16777215
    default 2500 if ARTOS_BUILD_TYPE = "Debug"
    default 800 if ARTOS_BUILD_TYPE = "MinSizeRel"
    default 500
    depends on ARTOS
    help
      If fewer SysTick clock cycles remain when scheduling is requested,
      switch to the idle thread and defer selection of a runnable thread
      until the next tick. A blocked thread is removed from the ready queue
      before the handoff. Zero disables the cutoff. Defaults are estimates
      for the 16 MHz boards; tune this value for the application and build
      configuration.

config ARTOS_MAX_THREADS
    int "Maximum number of threads (including idle)"
    range 2 64
    default 8
    depends on ARTOS
    help
      Maximum number of registered threads, including the kernel idle
      thread. Each thread's TCB and stack are allocated separately.

config ARTOS_MAX_THREAD_NAME_LENGTH
    int "Maximum thread name length (bytes)"
    range 1 63
    default 15
    depends on ARTOS
    help
      Maximum number of bytes in a thread name, excluding the terminating
      null byte. Each TCB and thread snapshot reserves this many bytes plus
      one, so names can be copied without a separate allocation.

config ARTOS_THREAD_STACK_HWM
    bool "Enable thread stack high-water-mark support"
    depends on ARTOS
    help
      Enable optional per-thread stack high-water-mark support.

config ARTOS_THREAD_STATS
    bool "Enable thread statistics"
    depends on ARTOS
    help
      Enable optional per-thread statistics collection.

config ARTOS_RUNTIME_HISTORY_WINDOW_MS
    int "Thread runtime history window (milliseconds)"
    range 1 3600000
    default 1000
    depends on ARTOS_THREAD_STATS
    help
      Total time covered by each thread's runtime history. History buckets
      accumulate CPU cycles; this value only sets their time span.

config ARTOS_RUNTIME_HISTORY_BUCKET_COUNT
    int "Thread runtime history bucket count"
    range 1 1000
    default 10
    depends on ARTOS_THREAD_STATS
    help
      Divide the history window into this many equal-duration buckets.
      The history window must divide evenly by the bucket count. Each
      bucket occupies four bytes per thread.

config ARTOS_MAIN_THREAD_STACK_SIZE
    int "Main thread stack size in bytes"
    range 1024 65536
    default 4096
    depends on ARTOS
    help
      Size of the statically allocated stack for the main thread. The value
      must be at least the minimum supported thread stack size and aligned to
      the CPU port's stack alignment.

config ARTOS_MAIN_THREAD_PRIORITY
    int "Main thread priority"
    range 0 255
    default 0
    depends on ARTOS
    help
      Scheduler priority assigned to the main thread. Zero is the highest
      priority. Use a value below ARTOS_PRIORITY_LEVELS; the default is the
      highest priority.

config ARTOS_MAX_DEFERRED_WORK_ITEMS
    int "Maximum number of registered deferred work items"
    range 1 64
    default 8
    depends on ARTOS
    help
      Capacity of the static deferred callback registration table.
      Each slot represents one registered callback, not one interrupt or
      event occurrence. Multiple pending requests can coalesce in a slot.
      This limit is independent of the maximum number of threads.

config ARTOS_MAX_ACTIVE_GUARDS
    int "Maximum number of active static initialization guards"
    range 1 64
    default 8
    depends on ARTOS
    help
      Capacity of the static runtime table used to coordinate concurrent
      initialization of function-local static objects. Each initialization
      in progress consumes one slot, including nested initializations in the
      same thread. This limit is independent of the maximum number of threads.

config ARTOS_PRIORITY_LEVELS
    int "Scheduler priority levels"
    range 1 256
    default 16
    depends on ARTOS

config ARTOS_SCHEDULER_FIXED_PRIORITY_ROUND_ROBIN
    bool
    default y if ARTOS

config ARTOS_SCHEDULER_PRIORITY_AGING
    bool "Enable priority aging"
    depends on ARTOS_SCHEDULER_FIXED_PRIORITY_ROUND_ROBIN
    help
      Increase the effective priority of runnable threads as they wait,
      preventing lower-priority threads from starving indefinitely.

config ARTOS_PRIORITY_AGING_TICKS
    int "Ticks between effective priority increases"
    range 1 2147483647
    default ARTOS_TICK_HZ
    depends on ARTOS_SCHEDULER_FIXED_PRIORITY_ROUND_ROBIN && ARTOS_SCHEDULER_PRIORITY_AGING
    help
      Number of kernel ticks a runnable thread must wait before its effective
      priority is increased by one level. Its configured base priority is not
      changed. The default interval is one second at the configured tick rate.

endmenu

source "modules/console/Kconfig"
source "modules/monitor/Kconfig"
```

## bsp/boards/st/nucleo_f439zi/Kconfig
```kconfig
config BOARD_NUCLEO_F439ZI
    bool "ST NUCLEO-F439ZI (STM32F439ZI, Cortex-M4F)"
    select SOC_STM32F439
    help
      2 MiB flash, 192 KiB system SRAM and 64 KiB CCM SRAM.
      USART3 console on PD8/PD9, green LED on PB0. Start on 16 MHz HSI.
```

## bsp/nucleo_f411re/Kconfig
```kconfig
config BOARD_NUCLEO_F411RE
    bool "ST NUCLEO-F411RE (STM32F411RE, Cortex-M4F)"
    help
      512 KiB flash, 128 KiB SRAM, and a USART2 console on PA2/PA3.
      Hardware clock and pin configuration live in this BSP's board.h.
```

## bsp/soc/st/stm32f4/Kconfig
```kconfig
config SOC_STM32F411
    bool
    select CPU_CORTEX_M4F
    select CPU_HAS_STACK_PROTECTION

config SOC_STM32F439
    bool
    select CPU_CORTEX_M4F
    select CPU_HAS_STACK_PROTECTION

config CPU_HAS_STACK_PROTECTION
    bool

config CPU_CORTEX_M4F
    bool

config SOC_PATH
    string
    default "st/stm32f4/stm32f411" if SOC_STM32F411
    default "st/stm32f4/stm32f439" if SOC_STM32F439

config SOC_NAME
    string
    default "stm32f411" if SOC_STM32F411
    default "stm32f439" if SOC_STM32F439

config CPU_NAME
    string
    default "cortex_m4" if CPU_CORTEX_M4F
```

## configs/nucleo_f411re_defconfig
```kconfig
CONFIG_BOARD_NUCLEO_F411RE=y
CONFIG_ARTOS=y
CONFIG_ARTOS_TICK_HZ=1000
CONFIG_ARTOS_PRIORITY_LEVELS=16
CONFIG_ARTOS_MAX_THREADS=8
CONFIG_MONITOR=y
CONFIG_CONSOLE_RX_BUFFER_SIZE=256
```

## modules/console/Kconfig
```kconfig
menu "Console"

config CONSOLE
    bool "Enable buffered system console"
    depends on ARTOS
    default y
    help
      Build the system console on the UART selected by DTS artos,console.
      Requires ARTOS blocking waits and deferred RX processing.
      The receive buffer has one ISR producer and one thread consumer.

config CONSOLE_RX_BUFFER_SIZE
    int "Console receive buffer bytes"
    depends on CONSOLE
    range 2 65536
    default 256
    help
      Size of the static receive ring buffer. One slot is reserved, so
      usable capacity is one byte smaller. The linker checks RAM usage.

endmenu
```

## modules/monitor/Kconfig
```kconfig
menu "Monitor"

config MONITOR
    bool "Enable serial monitor"
    depends on CONSOLE
    default y
    help
      Build command parsing and line editing on the system console.
      Disabling the monitor leaves the console available to other clients.

endmenu
```
